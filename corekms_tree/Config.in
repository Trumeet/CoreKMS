## corekms_tree/configs/corekms_defconfig
```kconfig
BR2_x86_64=y
BR2_x86_corei7=y
BR2_CCACHE=y
BR2_TOOLCHAIN_BUILDROOT_MUSL=y
BR2_TARGET_GENERIC_HOSTNAME=""
BR2_TARGET_GENERIC_ISSUE=""
# BR2_TARGET_ENABLE_ROOT_LOGIN is not set
# BR2_TARGET_GENERIC_GETTY is not set
# BR2_TARGET_GENERIC_REMOUNT_ROOTFS_RW is not set
BR2_ROOTFS_OVERLAY="$(BR2_EXTERNAL_corekms_tree_PATH)/board/corekms/rootfs_overlay"
BR2_LINUX_KERNEL=y
BR2_LINUX_KERNEL_USE_CUSTOM_CONFIG=y
BR2_LINUX_KERNEL_CUSTOM_CONFIG_FILE="$(BR2_EXTERNAL_corekms_tree_PATH)/configs/kernel.config"
BR2_PACKAGE_BUSYBOX_CONFIG="$(BR2_EXTERNAL_corekms_tree_PATH)/configs/busybox.config"
BR2_PACKAGE_BUSYBOX_WATCHDOG=y
BR2_PACKAGE_GNU_EFI=y
BR2_PACKAGE_DHCPCD=y
# BR2_PACKAGE_IFUPDOWN_SCRIPTS is not set
# BR2_PACKAGE_URANDOM_SCRIPTS is not set
BR2_TARGET_ROOTFS_INITRAMFS=y
BR2_TARGET_ROOTFS_ISO9660=y
BR2_TARGET_ROOTFS_ISO9660_HYBRID=y
# BR2_TARGET_ROOTFS_TAR is not set
BR2_TARGET_SYSLINUX=y
BR2_PACKAGE_VLMCSD=y
```

## corekms_tree/package/vlmcsd/Config.in
```kconfig
config BR2_PACKAGE_VLMCSD
	bool "vlmcsd"
	help
	  Build the vlmcsd KMS emulator.
```
